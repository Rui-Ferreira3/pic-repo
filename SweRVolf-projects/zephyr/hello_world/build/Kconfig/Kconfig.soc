## SweRVolf-projects/zephyr/hello_world/build/Kconfig/Kconfig.soc
```kconfig
osource "/root/RVfpgaSoC/Labs/LabProjects/SweRVolf/fusesoc_libraries/swervolf/zephyr/soc/$(ARCH)/*/Kconfig.soc"
osource "/root/RVfpgaSoC/Labs/LabProjects/SweRVolf/zephyr/soc/$(ARCH)/*/Kconfig.soc"
```

## SweRVolf-projects/zephyr/philosophers/build/Kconfig/Kconfig.modules
```kconfig
osource "/root/RVfpgaSoC/Labs/LabProjects/SweRVolf/fusesoc_libraries/swervolf/zephyr/Kconfig"
```

## SweRVolf-projects/zephyr/philosophers/build/Kconfig/Kconfig.soc.arch
```kconfig
osource "/root/RVfpgaSoC/Labs/LabProjects/SweRVolf/fusesoc_libraries/swervolf/zephyr/soc/$(ARCH)/Kconfig"
osource "/root/RVfpgaSoC/Labs/LabProjects/SweRVolf/fusesoc_libraries/swervolf/zephyr/soc/$(ARCH)/*/Kconfig"
osource "/root/RVfpgaSoC/Labs/LabProjects/SweRVolf/zephyr/soc/$(ARCH)/Kconfig"
osource "/root/RVfpgaSoC/Labs/LabProjects/SweRVolf/zephyr/soc/$(ARCH)/*/Kconfig"
```

## SweRVolf-projects/zephyr/philosophers/build/Kconfig/Kconfig.soc.defconfig
```kconfig
osource "/root/RVfpgaSoC/Labs/LabProjects/SweRVolf/fusesoc_libraries/swervolf/zephyr/soc/$(ARCH)/*/Kconfig.defconfig"
osource "/root/RVfpgaSoC/Labs/LabProjects/SweRVolf/zephyr/soc/$(ARCH)/*/Kconfig.defconfig"
```
